## meta-bf/meta-jbay/conf/layer.conf
```bitbake
# We have a conf and classes directory, add to BBPATH
BBPATH .= ":${LAYERDIR}"

# We have recipes-* directories, add to BBFILES
BBFILES += "${LAYERDIR}/recipes-*/*/*.bb \
	${LAYERDIR}/recipes-*/*/*.bbappend"

BBFILE_COLLECTIONS += "jbay"
BBFILE_PATTERN_jbay = "^${LAYERDIR}/"
BBFILE_PRIORITY_jbay = "25"
```

## meta-bf/meta-jbay/conf/local.conf.sample
```bitbake
#
# Local configuration file for building the OpenBMC image.
#

# Machine Selection
MACHINE ??= "jbay"

# OpenBMC distro settings
DISTRO ?= "openbmc-fb"
```

## meta-bf/meta-mavericks/conf/machine/mavericks.conf
```bitbake
#@TYPE: Machine
#@NAME: Mavericks
#@DESCRIPTION: Machine configuration for Barefoot Mavericks

UBOOT_MACHINE_mavericks = "mavericks_config"

require conf/machine/include/ast1250.inc

# configuration for preferred version of packages
PREFERRED_VERSION_libipmi = "0.2"
PREFERRED_VERSION_ipmid = "0.1"
PREFERRED_VERSION_rest-api = "0.1"
PREFERRED_VERSION_kcsd = "0.2"

MACHINE_ESSENTIAL_EXTRA_RDEPENDS += "           \
    kernel-module-i2c-dev-sysfs                 \
    kernel-module-cpld                          \
    kernel-module-com-e-driver                  \
    kernel-module-i2c                           \
    "


TCLIBC = 'eglibc'
```
